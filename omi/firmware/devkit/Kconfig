## omi/firmware/devkit/Kconfig
```kconfig
source "Kconfig.zephyr"

menu "Omi Features Configuration"

config OMI_CODEC_OPUS
    bool "Opus Audio Codec"
    help
        "Enable the Opus audio codec support."
    default n

config OMI_ENABLE_OFFLINE_STORAGE
	bool "Offline SD Card Storage"
    select DISK_ACCESS
    select FILE_SYSTEM
    select FAT_FILESYSTEM_ELM
    select FS_FATFS_MOUNT_MKFS
    select FS_FATFS_EXFAT
    help
        "Enable the offline storage support. Requires a SD Card."
	default n

config OMI_ENABLE_ACCELEROMETER
    bool "Accelerometer Support"
    help
        "Enable the accelerometer support."
    default n

config OMI_ENABLE_BUTTON
    bool "Button support"
    help
        "Enable the software button support."
    default n

config OMI_ENABLE_SPEAKER
    bool "Enable the speaker"
    help
        "Enable the speaker support."
    default n

config OMI_ENABLE_BATTERY
    bool "Enable the battery"
    help
        "Enable the battery support."
    default n

if OMI_ENABLE_BATTERY

config OMI_BATTERY_GPIO_CHARGE_SPEED_PIN
    int "Battery charge-speed GPIO pin"
    default 13

config OMI_BATTERY_GPIO_CHARGING_ENABLE_PIN
    int "Battery charging-enable GPIO pin"
    default 17

config OMI_BATTERY_GPIO_CHARGE_STATUS_PIN
    int "Battery charge-status GPIO pin"
    default -1

config OMI_BATTERY_GPIO_READ_ENABLE_PIN
    int "Battery read-enable GPIO pin"
    default 14

config OMI_BATTERY_CHARGE_SPEED_ACTIVE_LOW
    bool "Charge-speed pin is active low"
    default y

config OMI_BATTERY_CHARGING_ENABLE_ACTIVE_LOW
    bool "Charging-enable pin is active low"
    default y

config OMI_BATTERY_CHARGE_STATUS_ACTIVE_LOW
    bool "Charge-status pin is active low"
    default y

config OMI_BATTERY_READ_ENABLE_ACTIVE_LOW
    bool "Read-enable pin is active low"
    default y

config OMI_BATTERY_ADC_R1_KOHM
    int "Battery divider R1 value (kOhm)"
    default 1037

config OMI_BATTERY_ADC_R2_KOHM
    int "Battery divider R2 value (kOhm)"
    default 510

endif

config OMI_ENABLE_USB
    bool "Enable the usb"
    help
        "Enable the USB power check support."
    default n

config OMI_ENABLE_HAPTIC
    bool "Enable the haptic"
    help
        "Enable the haptic support."
    default n

endmenu
```
